/*
  
  Modified Flash 8x8 LED
  
  hearing impaired notification with message type
  george craig
  
  this code is in the public domain
  
*/

#include <stdint.h>

//Define the "Normal" Colors
#define BLACK   0x00
#define RED     0xE0
#define GREEN   0x1C
#define BLUE    0x03
#define YELLOW  RED|GREEN
#define ORANGE  0xFC
#define MAGENTA RED|BLUE
#define TEAL    BLUE|GREEN
#define WHITE   (RED|GREEN|BLUE)-0xA0

unsigned char i;
unsigned char j;

/*Port Definitions*/
int Max7219_pinCLK = 10;
int Max7219_pinCS = 9;
int Max7219_pinDIN = 8;

unsigned char disp1[38][8] = {

  {0xff, 0xff, 0xff, 0xff, 0xff, 0xff, 0xff, 0xff}, // all LEDs
//  {0x81,0xc3,0xa5,0x99,0x81,0x81,0x81,0x81},// gmail
  {0xff, 0xc3, 0xa5, 0x99, 0x81, 0x81, 0x81, 0xff}, // letter for email
  {0x00, 0x0c, 0x10, 0x10, 0x38, 0x10, 0x10, 0x10}, // facebook
  {0x80, 0x00, 0xa1, 0xb3, 0xad, 0xa1, 0xa1, 0xa1}, // instant message
  {0x00, 0x18, 0x18, 0x3c, 0x7e, 0x7e, 0x08, 0x08}, // door bell
//  {0x00, 0x14, 0x14, 0x14, 0x36, 0x55, 0x55, 0x36}, // door bell
  {0x3c, 0x42, 0xa5, 0x81, 0xa5, 0x99, 0x42, 0x3c}, // smiley
  {0x3c, 0x42, 0xa5, 0x81, 0x99, 0xa5, 0x42, 0x3c}, // frowny
  {0x18, 0x18, 0x18, 0x18, 0x18, 0x00, 0x18, 0x18}, // exclamantion point
  {0x00, 0x00, 0x7e, 0xc3, 0x99, 0x3c, 0x7e, 0xff}, // phone call
  {0x00, 0xa0, 0xa0, 0xb1, 0xbb, 0xb5, 0xb1, 0x51}, // voice mail

  /*{0x3C,0x42,0x42,0x42,0x42,0x42,0x42,0x3C},//0
  {0x10,0x18,0x14,0x10,0x10,0x10,0x10,0x10},//1
  {0x7E,0x2,0x2,0x7E,0x40,0x40,0x40,0x7E},//2
  {0x3E,0x2,0x2,0x3E,0x2,0x2,0x3E,0x0},//3
  {0x8,0x18,0x28,0x48,0xFE,0x8,0x8,0x8},//4
  {0x3C,0x20,0x20,0x3C,0x4,0x4,0x3C,0x0},//5
  {0x3C,0x20,0x20,0x3C,0x24,0x24,0x3C,0x0},//6
  {0x3E,0x22,0x4,0x8,0x8,0x8,0x8,0x8},//7
  {0x0,0x3E,0x22,0x22,0x3E,0x22,0x22,0x3E},//8
  {0x3E,0x22,0x22,0x3E,0x2,0x2,0x2,0x3E},//9   */

  {0x8, 0x14, 0x22, 0x3E, 0x22, 0x22, 0x22, 0x22}, //A
  {0x3C, 0x22, 0x22, 0x3E, 0x22, 0x22, 0x3C, 0x0}, //B
  {0x3C, 0x40, 0x40, 0x40, 0x40, 0x40, 0x3C, 0x0}, //C
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  {0x0, 0x7F, 0x2, 0x4, 0x8, 0x10, 0x20, 0x7F}, //Z

};

void Write_Max7219_byte(unsigned char DATA)
{
  unsigned char i;
  digitalWrite(Max7219_pinCS, LOW);
  for (i = 8; i >= 1; i--)
  {
    digitalWrite(Max7219_pinCLK, LOW);
    digitalWrite(Max7219_pinDIN, DATA & 0x80); // Extracting a bit data
    DATA = DATA << 1;
    digitalWrite(Max7219_pinCLK, HIGH);
  }
}

void Write_Max7219(unsigned char address, unsigned char dat)
{
  digitalWrite(Max7219_pinCS, LOW);
  Write_Max7219_byte(address);           //address，code of LED
  Write_Max7219_byte(dat);               //data，figure on LED
  digitalWrite(Max7219_pinCS, HIGH);
}

void Init_MAX7219(void)
{
  Write_Max7219(0x09, 0x00);       //decoding ：BCD
  Write_Max7219(0x0a, 0x03);       //brightness
  Write_Max7219(0x0b, 0x07);       //scanlimit；8 LEDs
  Write_Max7219(0x0c, 0x01);       //power-down mode：0，normal mode：1
  Write_Max7219(0x0f, 0x00);       //test display：1；EOT，display：0
}

void setup()
{
  pinMode(Max7219_pinCLK, OUTPUT);
  pinMode(Max7219_pinCS, OUTPUT);
  pinMode(Max7219_pinDIN, OUTPUT);
  delay(50);
  Init_MAX7219();

  //Serial.begin(9600);
}

void clear_screen() {
  unsigned char row[8] = {0x0, 0x0, 0x0, 0x0, 0x0, 0x0, 0x0, 0x0};
  for (i = 1; i < 9; i++)
    Write_Max7219(i, --(*row));
  delay(75);
}

void full_screen() {
  unsigned char row[8] = {0xff, 0xff, 0xff, 0xff, 0xff, 0xff, 0xff, 0xff};
  for (i = 1; i < 9; i++)
    Write_Max7219(i, --(*row));
  delay(75);
}

void draw() {
//unsigned char r[8] = {0x00, 0x0c, 0x10, 0x10, 0x38, 0x10, 0x10, 0x10}; // facebook
//unsigned char r[8] = {0xff, 0xc3, 0xa5, 0x99, 0x81, 0x81, 0x81, 0xff}; // letter for email
//unsigned char r[8] = {0x80, 0x00, 0xa1, 0xb3, 0xad, 0xa1, 0xa1, 0xa1};   // instant message
 unsigned char r[8] = {0x00, 0x00, 0x7e, 0xc3, 0x99, 0x3c, 0x7e, 0xff}; // phone call
  for (i = 1; i < 9; i++)
      Write_Max7219(i, r[i-1]);
      //Write_Max7219(i, *r);
  delay(75);
}

//int f = 0;
void loop()
{
    
    int m=0;
    for (m = 0; m < 5; m++) {
      fullScreen();
      delay(75);
      clearScreen();
    }

    draw();    
    delay(2000);
    clearScreen();
       
 
// below are tests for display, need caps and resistors
// or can it be driven as is by the atmel?
    

  //f++;
  //if (f>1)
  //goto stop;

  /*
    int m = 0;

    for (m = 0; m < 10; m++) {
      int j = 0;
      for (i = 1; i < 9; i++)
        Write_Max7219(i, disp1[j][i - 1]);
      delay(75);
    }

    delay(10);

  for (j = 0; j < 38; j++)
  {
    for (i = 1; i < 9; i++)
      Write_Max7219(i, disp1[j][i - 1]);
    delay(2000);
  }

  stop:

    Serial.print ("stopped");
  */
}
